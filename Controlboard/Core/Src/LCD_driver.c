/*----------------------------------------------------------
//MODULE		:思迈微12864-(128X64Pixls)
//AUTHOR		:深圳思迈微电子 赵工
//店铺链接：https://shop358474914.taobao.com/?spm=a1z10.1-c-s.0.0.bf0236655W5gvp
//我司提供技术支持，任何技术问题欢迎随时交流学习
//创建日期:2016-04-17
//版本：V1.1
//版权所有，盗版必究。
//Copyright(C) 思迈微电子2016-2026
//All rights reserved
//CONTROLLER	:ST7565R	(Parallel	Interface)
//Revision	:VCC=3.3V
//		:Boost=4X
//		:V0-Vss=9.0V (1/64 duty,1/9 bias)
//		:Com31~Com0, Com63~Com32, Seg1~128
//----------------------------------------------------------*/
#include "LCD_driver.h"     

#include "font.h"
#include <string.h>
#include <stdarg.h>
#include <stdio.h>
#include "oled_font.h"
const uint8_t OLED_F10x16[][40]=
{
0x00,0x40,0x40,0x40,0xFC,0x40,0x40,0xC0,0x80,0xF8,0x40,0x40,0xFE,0x20,0x20,0x20,
0xF0,0x00,0x00,0x00,0x00,0x20,0x20,0x10,0x1F,0x10,0x08,0x08,0x00,0x7F,0x40,0x40,
0x4F,0x40,0x44,0x44,0x47,0x70,0x60,0x00,/*"地",0*/
0x00,0x00,0x40,0x40,0xFE,0x40,0x20,0x00,0x00,0xE0,0x00,0x00,0x00,0xFE,0x80,0x80,
0x80,0x40,0x00,0x00,0x00,0x20,0x10,0x10,0x1F,0x08,0x48,0x40,0x40,0x7F,0x40,0x40,
0x40,0x7F,0x40,0x40,0x40,0x60,0x40,0x00,/*"址",1*/
};
const uint8_t OLED_F16x16[][32]=
{
0x20,0x20,0x20,0xFF,0x20,0x20,0x80,0xF8,0x80,0x40,0xFF,0x20,0x10,0xF0,0x00,0x00,
0x10,0x30,0x10,0x0F,0x08,0x08,0x00,0x3F,0x40,0x40,0x5F,0x42,0x44,0x43,0x78,0x00,/*"地",0*/
0x20,0x20,0x20,0xFF,0x20,0x20,0x00,0xF8,0x00,0x00,0xFF,0x40,0x40,0x40,0x00,0x00,
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0x40,0x30,0x8F,0x80,0x84,0x4C,0x55,0x25,0x25,0x25,0x55,0x4C,0x80,0x80,0x80,0x00/*"度",5*/
};

/****
*	功能：写数据到液晶屏
*	输入：_ucCmd=数据寄存器或者命令寄存器,_ucData=数据
*	输出：无
****/
static void LCD_Write(uint8_t _ucReg,uint8_t _ucData)
{
	uint8_t i;
	if(_ucReg)	LCD_RS_H();
	else		LCD_RS_L();
	for(i=0;i<8;i++)
	{
		LCD_CLK_L();
		if(_ucData & 0x80)	LCD_SDA_H();
		else				LCD_SDA_L();
		LCD_CLK_H();
		_ucData <<= 1;
	}
	
}

/****
*	功能：初始化液晶屏
*	输入：无
*	输出：无
****/
void LCD_Init(void)
{
	LCD_CS_L();
	LCD_RES_L();				/*低电平复位*/
	LCD_Delayms(20);
	LCD_RES_H();				/*复位完成*/
	LCD_Delayms(20);
	LCD_Write(REG_CMD,0XE2);	/*软复位*/
	LCD_Delayms(5);
	LCD_Write(REG_CMD,0x2c);	/*升压1*/
	LCD_Delayms(5);
	LCD_Write(REG_CMD,0x2e);	/*升压2*/
	LCD_Delayms(5);
	LCD_Write(REG_CMD,0x2f);	/*升压3*/
	LCD_Delayms(5);	
	LCD_Write(REG_CMD,0x24);	/*粗调对比度，0x20-0x27*/
	LCD_Write(REG_CMD,0x81);	/*微调对比度*/
	LCD_Write(REG_CMD,0x1b);	/*微调对比度值，0x00-0x3f*/
	LCD_Write(REG_CMD,0xa2);	/*1/9偏压比*/
	LCD_Write(REG_CMD,0xc8);	/*行扫描顺序：从上到下*/
	LCD_Write(REG_CMD,0xa0);	/*列扫描顺序：从左到右*/
	LCD_Write(REG_CMD,0x60);	/*起始行：第一行开始*/	
//	LCD_Write(REG_CMD,0xA7);	/*反显*/	
	LCD_Write(REG_CMD,0xaf);	/*开显示*/
	LCD_CS_H();
}
//
/****
*	功能：设置屏幕的位置
*	输入：无
*	输出：无
****/
static void LCD_SetPos(uint8_t _ucPage,uint8_t _ucColumn)
{
	LCD_CS_L();

//	_ucPage -= 1;
	LCD_Write(REG_CMD,0xb0+_ucPage);
	LCD_Write(REG_CMD,((_ucColumn>>4) & 0x0f) + 0x10);
	LCD_Write(REG_CMD,(_ucColumn & 0x0f));
}

void  LCD_Set_Buffer(int   x, int   y , uint8_t *dat , uint16_t size) 
{
      int j=0;
      if(x<0||x>=128||y<0||y>=8)  return  ;
#if OLED_EN_DIS_BUFFER == 0	  //  直写寄存器模式
         y+=4;
        if(y>=8)
        {
            y-=8;
        }   
        LCD_SetPos(y,x);
        for(j=0; j<size; j++)
		{
			LCD_Write(REG_DATA,*(dat+j));
		}
        
#else                            //   显存模式
      if(y*128 + x + size > sizeof(oledDisBuffer))  return ; //  防止越界
    memcpy(oledDisBuffer[y]+x,dat,size) ;
#endif	
}   	  
/****
*	功能：清屏
*	输入：无
*	输出：无
****/
void LCD_Clear(void)
{
	uint8_t i,j;
	LCD_CS_L();
	for(i=0; i<9; i++)
	{
		LCD_SetPos(i,1);
		for(j=0; j<132; j++)
		{
			LCD_Write(REG_DATA,0x00);
		}
	}
	LCD_CS_H();
}

void LCD_Clear_2(void)
{
	uint8_t j;
	LCD_CS_L();

		LCD_SetPos(4,124);
		for(j=0; j<4; j++)
		{
			LCD_Write(REG_DATA,0x00);
		}
	LCD_CS_H();
}
/****
*	功能：显示单个8*16字符
*	输入：无
*	输出：无
****/
void LCD_DispChar8x16(uint8_t _ucPage,uint8_t _ucColumn,uint8_t *p)
{
	uint8_t i,j;
	LCD_CS_L();

	for(j=0; j<2; j++)
	{
        
		LCD_SetPos(_ucPage+j,_ucColumn);
		for(i=0; i<8; i++)
		{
			LCD_Write(REG_DATA,*p);
			p++;
		}
		
	}
	LCD_CS_H();
}
//
//m^n函数
//返回值:m^n次方.
uint32_t LCD_Pow(uint8_t m,uint8_t n)
{
	uint32_t result=1;	 
	while(n--)result*=m;    
	return result;
}		
/****
*	功能：显示8*16字符串
*	输入：无
*	输出：无
****/
void LCD_DispStr8x16(uint8_t _ucPage,uint8_t _ucColumn,char *str)
{
	uint8_t num,i;
	uint8_t  buff[16];
	while(*str != '\0')
	{
		num = *str - ' ';/*定位字符在二维数组中的位置*/
		for(i=0; i<16; i++)/*获取字符的取模数据*/
		{
			buff[i] = ASCII_8X16[num][i];
		}
		LCD_DispChar8x16(_ucPage,_ucColumn,buff);
		_ucColumn += 8;
		str++;
	}
}

/****
*	功能：显示8*16字符数字
*	输入：
*	输出：无
****/
void LCD_DispNum(uint8_t _ucPage,uint8_t _ucColumn,uint16_t num,uint8_t _ucLenth)
{    	
	uint8_t i,t,temp;
	uint8_t enshow=0;	
	uint8_t buff[16];
	for(t=0;t<_ucLenth;t++)
	{
		temp=(num/LCD_Pow(10,_ucLenth-t-1))%10;
		if(enshow==0&&t<(_ucLenth-1))
		{
			if(temp==0)
			{
				LCD_DispStr8x16(_ucPage,_ucColumn+8*t," ");
				continue;
			}else enshow=1; 
		}
		temp += 16 ;
		for(i=0; i<16; i++)/*获取字符的取模数据*/
		{
			buff[i] = ASCII_8X16[temp][i];
		}
	 	LCD_DispChar8x16(_ucPage,_ucColumn+8*t,buff); 
	}
}
//

void LCD_Dis_String(int  x,int   y,   char disMode, char  *string)
{
    int index=0;
    uint8_t   c= 0         ;
  uint8_t  	buffer[128]  ; 
    while (string[index]>0)
    {		
        c = string[index] ;
        switch(disMode)
        {
            case 10:
            case  0:
                        if(c < 0x80)  //  ASCII 字符 
                                {
                                     memcpy((char *)buffer,ASCII5X7Code[c- ' '],6);
                                     if(disMode == 10)  {
                                       int i;
                                         for(i=0;i<6;i++) buffer[i] = ~buffer[i];
                                     }
                                     LCD_Set_Buffer(x,y,buffer,6);
                                     x += 6;	
                                     if(x>128-6){x=0;y=y+1;}	// 自动换行
                              } 
                        break;
                                
            case 11:					
            case 1 :
                if(c < 0x80)  //  ASCII 字符 
                                {
                                        c -= ' ' ;
                                      memcpy((char *)buffer,ASCII8X16Code[c],16);
                                      if(disMode == 11)  {
                                       int i;
                                         for(i=0;i<16;i++) buffer[i] = ~buffer[i];
                                     }
                                        LCD_Set_Buffer(x,y,buffer,8);						
                                        LCD_Set_Buffer(x,y+1,buffer+8,8);
                                        
                      }
                      x += 8;     //  自动换行
                      if(x>120)
                                {
                                     x=0  ;
                                     y=y+2;
                                } 
                    break;
#if ASCII12X24Code_EN != 0 								
      case 12:								
            case 2:
                if(c < 0x80)  //  ASCII 字符 
                                {
                                        c -= ' ' ;
                                      memcpy(buffer,ASCII12X24Code[c],36);
                                      if(disMode == 12)  {
                                       int i;
                                         for(i=0;i<36;i++) buffer[i] = ~buffer[i];
                                      }
                                        LCD_Set_Buffer(x,y,buffer,12);										
                                        LCD_Set_Buffer(x,y+1,buffer+12,12);
                    LCD_Set_Buffer(x,y+2,buffer+24,12);
                                                        
                      }
                      x += 12;     //  自动换行
                      if(x>116)
                                {
                                     x=0  ;
                                     y=y+3;
                                } 
                    break;  
#endif
                                
#if ASCII12X24Code_EN != 0
            case 13:					   
            case 3:
                if(c < 0x80)  //  ASCII 字符 
                                {
                                        c -= ' ' ;
                                      memcpy(buffer,ASCII16X32Code[c],64);
                                      if(disMode == 13)  {
                                       int i;
                                         for(i=0;i<64;i++) buffer[i] = ~buffer[i];
                                       }
                                        LCD_Set_Buffer(x,y,buffer,16);										
                                        LCD_Set_Buffer(x,y+1,buffer+16,16);
                    LCD_Set_Buffer(x,y+2,buffer+32,16);
                                        LCD_Set_Buffer(x,y+3,buffer+48,16);
                      }
                      x += 16;     //  自动换行
                      if(x>112)
                                {
                                     x=0  ;
                                     y=y+4;
                                } 
                    break; 
#endif								
      default:  
                    break;  
        }
        
        if(y > 7)  break;	  //  显示超行，退出
        index++;
    }
}


//  显示点阵信息
//  disMode :    1->16*16 ; 2->24*24 ; 3->32*32
void LCD_Dis_Date(int  x,int   y,   char disMode, char  *date , uint16_t  len)
{
  uint8_t  	buffer[128]  ; 
    while (len -- )
    {		
        switch(disMode)
        {								
            case 11:					
            case 1 : 
                                memcpy((char *)buffer,date,32);
                                if(disMode == 11)  
                                {
                                    int i;
                                    for(i=0;i<32;i++) buffer[i] = ~buffer[i];
                                }
                                LCD_Set_Buffer(x,y,buffer,16);						
                                LCD_Set_Buffer(x,y+1,buffer+16,16);
                      
                      x += 16; 
                date  += 32;								
                      if(x>128 - 16)   //  自动换行
                                {
                                     x=0  ;
                                     y=y+2;
                                } 
                    break;							
      case 12:								
            case 2:
                memcpy((char *)buffer,date,72);
                                if(disMode == 12)  
                                {
                                    int i;
                                    for(i=0;i<72;i++) buffer[i] = ~buffer[i];
                                }
                                LCD_Set_Buffer(x,y,buffer,24);						
                                LCD_Set_Buffer(x,y+1,buffer+24,24);
                                LCD_Set_Buffer(x,y+2,buffer+48,24);
                      
                      x += 24; 
                date  += 72;								
                      if(x > 128 - 24)   //  自动换行
                                {
                                     x=0  ;
                                     y=y+3;
                                } 
                    break;  

                                
            case 13:					   
            case 3:
                memcpy((char *)buffer,date,128);
                                if(disMode == 13)  
                                {
                                    int i;
                                    for(i=0;i<128;i++) buffer[i] = ~buffer[i];
                                }
                                LCD_Set_Buffer(x,y,buffer,32);						
                                LCD_Set_Buffer(x,y+1,buffer+32,32);
                                LCD_Set_Buffer(x,y+2,buffer+64,32);
                                LCD_Set_Buffer(x,y+3,buffer+96,32);
                      
                      x += 32; 
                 date  += 128;    								
                      if(x > 128 - 32)   //  自动换行
                                {
                                     x=0  ;
                                     y=y+4;
                                } 
                    break; 							
      default:  
                      break;  
        }
        
        if(y > 7)  break;	  //  显示超行，退出
    }
}



//  OLED 格式化输出
void LCD_Printf(int  x,int  y, char disMode , char *p,... )
{
      static  char buf[64];
    va_list ap;
        va_start(ap,p);
        vsprintf(buf,p,ap);
        va_end(ap);
      LCD_Dis_String(x,y,disMode,buf);
}

void OLED_ShowCN(uint8_t Line, uint8_t Column, uint8_t Num)  
{      	
	uint8_t wide=16;//字宽
    uint8_t  	buffer[128]  ; 
    memcpy((char *)buffer,OLED_F16x16[Num],wide);
	LCD_Set_Buffer(Column,Line,buffer,wide);
//	LCD_SetPos((Line-1)*2, (Column-1)*wide);		//参数1:把光标设置在第几页. 参数2:把光标设置在第几列
//	for (i = 0; i < wide; i++)
//	{
//		LCD_Write(REG_DATA,OLED_F10x16[Num][i]);			//显示上半部分内容
//	}
	memcpy((char *)buffer,OLED_F16x16[Num]+wide,wide);
	LCD_Set_Buffer(Column,Line+1,buffer,wide);
//	LCD_SetPos((Line-1)*2+1,(Column-1)*wide);		
//	for (i = 0; i < wide; i++)
//	{
//		LCD_Write(REG_DATA,OLED_F10x16[Num][i+wide]);		//显示下半部分内容
//	}
 
}



const uint8_t  oledDisplayTestCode16X16[]=
{
0x00,0x00,0x00,0xFE,0x92,0x92,0x92,0x92,0x92,0x92,0x92,0xFE,0x00,0x00,0x00,0x00,0x40,0x42,0x44,0x58,0x40,0x7F,0x40,0x40,0x40,0x7F,0x40,0x50,0x48,0x46,0x40,0x00,/*"显",0*/
0x40,0x40,0x42,0x42,0x42,0x42,0x42,0xC2,0x42,0x42,0x42,0x42,0x42,0x40,0x40,0x00,0x20,0x10,0x08,0x06,0x00,0x40,0x80,0x7F,0x00,0x00,0x00,0x02,0x04,0x08,0x30,0x00,/*"示",1*/
0x10,0x60,0x02,0x8C,0x00,0xFE,0x02,0xF2,0x02,0xFE,0x00,0xF8,0x00,0xFF,0x00,0x00,0x04,0x04,0x7E,0x01,0x80,0x47,0x30,0x0F,0x10,0x27,0x00,0x47,0x80,0x7F,0x00,0x00,/*"测",2*/
0x40,0x40,0x42,0xCC,0x00,0x90,0x90,0x90,0x90,0x90,0xFF,0x10,0x11,0x16,0x10,0x00,0x00,0x00,0x00,0x3F,0x10,0x28,0x60,0x3F,0x10,0x10,0x01,0x0E,0x30,0x40,0xF0,0x00/*"试",3*/
};
const uint8_t  oledDisplayTestCode24X24[]=
{
0x00,0x00,0x00,0x00,0x00,0x00,0xFC,0xFC,0x44,0x44,0x44,0x44,0x44,0x44,0x44,0x44,0x44,0xFC,0xFC,0x08,0x00,0x00,0x00,0x00,0x00,0x00,0x00,0x40,0xC0,0x80,0x8F,0x0F,0x0C,0xFC,0xF4,0x14,0x04,0x04,0xF4,0xF4,0x04,0x0F,0x8F,0xE0,0x60,0x20,0x00,0x00,0x00,0x00,0x10,0x10,0x10,0x13,0x17,0x17,0x10,0x1F,0x1F,0x10,0x10,0x10,0x1F,0x1F,0x16,0x13,0x11,0x10,0x18,0x18,0x10,0x00,/*"显",0*/
0x00,0x00,0x00,0x00,0x08,0x08,0x08,0x08,0x08,0x08,0x08,0x08,0x08,0x08,0x08,0x08,0x08,0x08,0x0C,0x0C,0x08,0x00,0x00,0x00,0x00,0x02,0x02,0x02,0x02,0x82,0xE2,0xF2,0x72,0x02,0x02,0xFE,0xFE,0xFE,0x02,0x12,0x32,0x62,0xC2,0x82,0x02,0x03,0x03,0x00,0x00,0x10,0x18,0x0C,0x07,0x03,0x01,0x10,0x10,0x30,0x70,0x7F,0x3F,0x1F,0x00,0x00,0x00,0x00,0x01,0x03,0x0F,0x0E,0x04,0x00,/*"示",1*/
0x00,0x80,0x80,0x04,0x1C,0x18,0x10,0xF8,0xF8,0xF8,0xC8,0xC8,0xC8,0xF8,0xF8,0xF8,0x00,0xC0,0xC0,0x40,0xFC,0xFC,0x00,0x00,0x00,0x00,0x01,0x07,0xC7,0xF8,0x3F,0xFF,0xFF,0xFF,0xFF,0xFF,0x3F,0xFF,0xFF,0xFF,0x00,0xFF,0xFF,0x00,0xFF,0xFF,0x00,0x00,0x00,0x00,0x01,0x3F,0x3F,0x7F,0x60,0x23,0x3B,0x1F,0x0F,0x07,0x04,0x1D,0x39,0x30,0x00,0x01,0x21,0x60,0x7F,0x7F,0x00,0x00,/*"测",2*/
0x00,0x00,0x00,0x08,0x38,0xF0,0xE0,0x00,0x80,0x80,0x80,0x80,0x80,0x80,0x80,0x8C,0xFC,0xF8,0x88,0x98,0xB8,0xF0,0xC0,0x80,0x00,0x04,0x04,0x04,0x04,0xFC,0xFC,0x04,0x08,0x08,0x08,0x08,0xF8,0xF8,0x0C,0x0C,0x3F,0xFF,0xE0,0x00,0x00,0x00,0x00,0x00,0x00,0x00,0x00,0x00,0x10,0x3F,0x3F,0x1C,0x06,0x1B,0x19,0x08,0x0F,0x07,0x04,0x06,0x02,0x01,0x07,0x1F,0x3C,0x30,0x7E,0x6E,/*"试",3*/
};

const uint8_t  oledDisplayTestCode32X32[]=
{

0x00,0x00,0x00,0x00,0x00,0x00,0x00,0x08,0xF8,0xF0,0x10,0x10,0x10,0x10,0x10,0x10,0x10,0x10,0x10,0x10,0x10,0x10,0x10,0xF8,0xF8,0xF0,0x00,0x00,0x00,0x00,0x00,0x00,0x00,0x00,0x00,0x00,0x00,0x00,0x00,0x00,0xFF,0xFF,0x42,0x42,0x42,0x42,0x42,0x42,0x42,0x42,0x42,0x42,0x42,0x42,0x42,0xFF,0xFF,0xFF,0x00,0x00,0x00,0x00,0x00,0x00,0x00,0x00,0x00,0x00,0x08,0x38,0x70,0xF1,0xE1,0xC0,0x00,0x00,0xFE,0xFE,0xFE,0x00,0x00,0x00,0xFE,0xFE,0xFE,0x00,0x80,0xC0,0xE0,0x78,0x3C,0x1C,0x08,0x00,0x00,0x00,0x00,0x00,0x10,0x10,0x10,0x10,0x10,0x11,0x13,0x13,0x10,0x10,0x1F,0x1F,0x1F,0x10,0x10,0x10,0x1F,0x1F,0x1F,0x16,0x13,0x11,0x10,0x10,0x18,0x18,0x18,0x10,0x00,0x00,/*"显",0*/
0x00,0x00,0x00,0x00,0x00,0x00,0x20,0x20,0x20,0x20,0x20,0x20,0x20,0x20,0x20,0x20,0x20,0x20,0x20,0x20,0x20,0x20,0x20,0x20,0x38,0x38,0x30,0x20,0x00,0x00,0x00,0x00,0x00,0x00,0x20,0x20,0x20,0x20,0x20,0x20,0x20,0x20,0x20,0x20,0x20,0x20,0x20,0xE0,0xE0,0xE0,0x20,0x20,0x20,0x20,0x20,0x20,0x20,0x20,0x20,0x30,0x30,0x30,0x20,0x00,0x00,0x00,0x00,0x00,0x00,0x80,0xC0,0xF0,0x7C,0x3E,0x1E,0x06,0x04,0x00,0x00,0xFF,0xFF,0xFF,0x00,0x00,0x02,0x06,0x0C,0x18,0x78,0xF0,0xE0,0xC0,0x80,0x00,0x00,0x00,0x00,0x00,0x08,0x0C,0x07,0x03,0x01,0x00,0x00,0x08,0x08,0x18,0x10,0x30,0x70,0x7F,0x3F,0x1F,0x00,0x00,0x00,0x00,0x00,0x00,0x00,0x00,0x01,0x07,0x07,0x03,0x00,0x00,/*"示",1*/
0x00,0x00,0x00,0x00,0x0C,0x1C,0x78,0x70,0x60,0x00,0xF8,0xF8,0xF0,0x10,0x10,0x10,0x10,0x10,0xF0,0xF0,0xF0,0x00,0x80,0x80,0x80,0x00,0x00,0xFC,0xFC,0xF8,0x00,0x00,0x00,0x00,0x04,0x1C,0x7C,0x78,0x30,0xC0,0xF8,0x38,0xFF,0xFF,0xFF,0x00,0xFF,0xFF,0xFE,0x02,0xFF,0xFF,0xFF,0x00,0xFF,0xFF,0xFF,0x01,0x00,0xFF,0xFF,0xFF,0x00,0x00,0x00,0x20,0x20,0x60,0xE0,0xF0,0xFC,0x3F,0x03,0x00,0x7F,0x7F,0x3F,0xE0,0xFF,0xFF,0x80,0x00,0x3F,0x3F,0x1F,0x00,0xFF,0xFF,0xFF,0x00,0x00,0xFF,0xFF,0xFF,0x00,0x00,0x00,0x00,0x00,0x00,0x1F,0x1F,0x1F,0x40,0x60,0x30,0x18,0x1C,0x0F,0x07,0x01,0x00,0x01,0x07,0x1E,0x3C,0x3C,0x00,0x00,0x10,0x10,0x30,0x70,0x7F,0x3F,0x0F,0x00,0x00,/*"测",2*/
0x00,0x00,0x00,0x00,0x10,0x30,0xF0,0xE0,0xC0,0x00,0x00,0x00,0x00,0x00,0x00,0x00,0x00,0x00,0x00,0x00,0x00,0xFC,0xFC,0xF8,0x08,0x18,0x38,0xF0,0xF0,0x80,0x00,0x00,0x00,0x40,0x40,0x40,0x40,0x40,0xC1,0xE1,0xE1,0x40,0x02,0x82,0x82,0x82,0x82,0x82,0x82,0x82,0x82,0xC2,0xC2,0xFF,0xFF,0xFF,0x02,0x02,0x02,0x02,0x03,0x03,0x02,0x00,0x00,0x00,0x00,0x00,0x00,0x00,0xFF,0xFF,0xFF,0x00,0x00,0x80,0xC0,0x40,0x00,0xFF,0xFF,0xFF,0x00,0x00,0x80,0x80,0x8F,0x7F,0xFE,0xE0,0x80,0x00,0x00,0x80,0x80,0x00,0x00,0x00,0x00,0x00,0x00,0x00,0x1F,0x3F,0x3F,0x1E,0x07,0x05,0x0C,0x0C,0x06,0x07,0x03,0x03,0x03,0x01,0x01,0x00,0x00,0x00,0x01,0x07,0x0F,0x1E,0x3C,0x7F,0x7F,0x00,/*"试",3*/
};
